## main/Kconfig.projbuild
```kconfig
menu "ESP32-S3 Remote HID"

config REMOTE_HID_WIFI_SSID
    string "Wi-Fi SSID"
    default ""
    help
        Wi-Fi station SSID. Keep credentials in sdkconfig.defaults.local.

config REMOTE_HID_WIFI_PASSWORD
    string "Wi-Fi password"
    default ""
    help
        Wi-Fi station password. This value must not be committed.

config REMOTE_HID_WIFI_PMF_REQUIRED
    bool "Require Protected Management Frames (PMF)"
    default n
    help
        Require the Wi-Fi access point to support Protected Management Frames.
        Leave disabled for compatibility with WPA2 routers that do not provide
        PMF. WPA2 authentication is still required.

config REMOTE_HID_API_TOKEN
    string "API bearer token"
    default ""
    help
        Random token required by REST and WebSocket clients. This value must
        not be committed.

config REMOTE_HID_KEY_HOLD_TIMEOUT_MS
    int "Maximum held-key inactivity timeout (ms)"
    range 1000 600000
    default 10000

config REMOTE_HID_KEY_PRESS_DURATION_MS
    int "Default key press duration (ms)"
    range 1 1000
    default 50

endmenu
```

## sdkconfig.defaults
```kconfig
CONFIG_IDF_TARGET="esp32s3"
CONFIG_REMOTE_HID_WIFI_PMF_REQUIRED=n
CONFIG_FREERTOS_HZ=1000
CONFIG_TINYUSB_HID_COUNT=1
CONFIG_TINYUSB_CDC_ENABLED=n
CONFIG_TINYUSB_DEBUG_LEVEL=0
CONFIG_HTTPD_WS_SUPPORT=y
CONFIG_HTTPD_WS_PRE_HANDSHAKE_CB_SUPPORT=y
CONFIG_COMPILER_OPTIMIZATION_SIZE=y
```
